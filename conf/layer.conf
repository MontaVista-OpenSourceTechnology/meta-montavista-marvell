## conf/layer.conf
```bitbake
# We have a conf and classes directory, add to BBPATH
BBPATH := "${BBPATH}:${LAYERDIR}"

# We have an images and various recipe-* directories, add to BBFILES
BBFILES := "${BBFILES} ${LAYERDIR}/recipes*/*/*.bb*"
	
BBFILE_COLLECTIONS += "cgx-msd-marvell-octeontx"
BBFILE_PATTERN_cgx-msd-marvell-octeontx := "^${LAYERDIR}/"
BBFILE_PRIORITY_cgx-msd-marvell-octeontx = "7"

LAYERDEPENDS = "core"

LAYERSERIES_COMPAT_cgx-msd-marvell-octeontx = "kirkstone"
```

## conf/machine/include/marvell-octeontx.inc
```bitbake
# Cavium ThunderX defaults

require conf/machine/include/soc-family.inc
require conf/machine/include/arm/armv8a/tune-thunderx.inc

SOC_FAMILY = "cavium-octeontx"

# used by sysvinit_2

SERIAL_CONSOLE ?= "115200 ttyAMA0"
```
